## main/Kconfig.projbuild
```kconfig
menu "Router Wi-Fi AP"

    config ROUTER_AP_SSID
        string "Wi-Fi SSID"
        default "ESP32-S31-Router"
        help
            Access point name, from 1 to 32 bytes.

    config ROUTER_AP_PASSWORD
        string "Wi-Fi password"
        default "ChangeMe-S31!"
        help
            WPA2 password, from 8 to 63 bytes. Change the default before use.

    config ROUTER_AP_CHANNEL
        int "Wi-Fi channel (2.4 GHz)"
        range 1 11
        default 6

    config ROUTER_AP_MAX_CLIENTS
        int "Maximum connected devices"
        range 1 10
        default 4

    config ROUTER_FALLBACK_DNS
        string "Fallback IPv4 DNS server"
        default "1.1.1.1"
        help
            Used only when the Ethernet DHCP lease supplies no IPv4 DNS server.

endmenu
```

## sdkconfig.defaults
```kconfig
CONFIG_ETH_ENABLED=y
CONFIG_ETH_USE_ESP32_EMAC=y
CONFIG_ETH_TRANSMIT_MUTEX=y
CONFIG_ETH_EMAC_RGMII_TX_CLK_SRC_APLL=y
CONFIG_LWIP_IP_FORWARD=y
CONFIG_LWIP_IPV4_NAPT=y
CONFIG_LWIP_DHCPS_MAX_STATION_NUM=10
CONFIG_ESP_NETIF_SET_DNS_PER_DEFAULT_NETIF=y
CONFIG_CJSON_NESTING_LIMIT=8

CONFIG_ETHERNET_INTERNAL_SUPPORT=y
CONFIG_ETHERNET_PHY_INTERFACE_RGMII=y
CONFIG_ETHERNET_PHY_YT8531=y
CONFIG_ETHERNET_PHY_ADDR=-1
CONFIG_ETHERNET_MDC_GPIO=5
CONFIG_ETHERNET_MDIO_GPIO=6
CONFIG_ETHERNET_PHY_RST_GPIO=7
CONFIG_ETHERNET_RGMII_PHY_REF_CLK_GPIO=-1
CONFIG_ETHERNET_PHY_YT8531_RGMII_RXC_DLY_EN=y
CONFIG_ETHERNET_PHY_YT8531_RGMII_RX_DELAY_SEL=0
CONFIG_ETHERNET_PHY_YT8531_RGMII_TX_DELAY_SEL=13
CONFIG_ETHERNET_PHY_YT8531_RGMII_TX_DELAY_SEL_FE=13
CONFIG_ESPTOOLPY_FLASHSIZE_16MB=y
CONFIG_PARTITION_TABLE_CUSTOM=y
CONFIG_PARTITION_TABLE_CUSTOM_FILENAME="partitions.csv"
CONFIG_SPIRAM=y
CONFIG_SPIRAM_SPEED_100M=y
CONFIG_SPIRAM_USE_MALLOC=y
CONFIG_SPIRAM_MALLOC_ALWAYSINTERNAL=4096
CONFIG_FATFS_LFN_HEAP=y
CONFIG_FATFS_API_ENCODING_UTF_8=y
CONFIG_FATFS_FS_LOCK=16
CONFIG_FATFS_TIMEOUT_MS=10000
CONFIG_FATFS_USE_FASTSEEK=n
CONFIG_FATFS_VOLUME_COUNT=1
CONFIG_FATFS_SECTOR_4096=y
```
